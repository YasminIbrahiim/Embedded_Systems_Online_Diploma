AUTOSAR XML (schema 00046)
standard types defined: uint8
package /myDataPack
  physical dimension distance_in_meters: length-exp=1
  unit meters: factor-si-to-unit=1, physical-dimension=distance_in_meters
  app type MyMetersType: category=VALUE, compu {identical; unit meters}
  application array data type MyMetersArrayType: category=ARRAY
    element element: category=VALUE, type=MyMetersType
  application record data type MyMetersStructType: category=STRUCTURE
    application record element x: type=MyMetersType
    application record element x: type=MyMetersType
  base type my_sint8: base-type-size=8, base-type-encoding=2C, mem-alignment=1, native-declaration=signed char
  base type my_uint8: base-type-size=8, base-type-encoding=NONE, mem-alignment=1, native-declaration=unsigned char
  range DC_uint8: phys 0..255, raw 0..255
  data type mapping set Data_Type_Mapping: data-type-map{application-data-type=MyMetersType, implementation-data-type=uint8}
